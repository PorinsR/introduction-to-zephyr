## workspace/boards/custom/powerboard/Kconfig.powerboard
```kconfig
# Copyright (c) 2024 Gerson Fernando Budke <nandojve@gmail.com>
# SPDX-License-Identifier: Apache-2.0

config BOARD_POWERBOARD
	select SOC_SAM4S8C
```

## workspace/boards/custom/powerboard/board.yml
```yaml
board:
  name: powerboard
  full_name: G360 Powerboard
  vendor: atmel
  socs:
    - name: sam4s8c
```

## workspace/modules/ili9806/drivers/ili9806/Kconfig
```kconfig
config ILI9806
	bool "ILI9806 display driver"
	default y
	depends on DT_HAS_ILITEK_ILI9806_ENABLED
	select MIPI_DBI
	select MIPI_DBI_3WIRE
	select ILI9XXX
	help
	  Enable driver for ILI9806 display driver.
```

## workspace/modules/ili9806/dts/bindings/display/ilitek,ili9806.yaml
```yaml
# Copyright (c) 2018, Jan Van Winkel <jan.van_winkel@dxplore.eu>
# Copyright (c) 2020, Teslabs Engineering S.L.
# SPDX-License-Identifier: Apache-2.0

title: Ilitek ILI9806 display controller

description: |
    The Ilitek ILI9806 is a TFT-LCD controller

compatible: "ilitek,ili9806"

include:  [display-controller.yaml, mipi-dbi-spi-device.yaml]


properties:
  pixel-format:
    type: int
    default: 0
    enum:
      - 0 # RGB565
      - 1 # RGB888
    description:
      Display pixel format. Note that when RGB888 pixel format is selected
      only 6 color bits are actually used being in practice equivalent to
      RGB666.
  rotation:
    type: int
    default: 0
    enum:
      - 0
      - 90
      - 180
      - 270
    description:
      Display rotation (CW) in degrees.
      If not defined, rotation is off by default.

  display-inversion:
    type: boolean
    description:
      Display inversion mode. Every bit is inverted from the frame memory to
      the display.

  gamset:
    type: uint8-array
    default: [0x01]
    description:
      Gamma set (GAMSET) register value.

  frmctr1:
    type: uint8-array
    default: [0x00, 0x1b]
    description:
      Frame rate control (in normal mode / full colors) (FRMCTR1) register value.

  disctrl:
    type: uint8-array
    default: [0x0a, 0x82, 0x27]
    description:
      Display function control (DISCTRL) register value. Note that changing
      default SS bit value (0) may interfere with display rotation.

  pwctrl1:
    type: uint8-array
    default: [0x26, 0x00]
    description:
      Power control 1 (PWCTRL1) register values.

  pwctrl2:
    type: uint8-array
    default: [0x00]
    description:
      Power control 2 (PWCTRL2) register values.

  vmctrl1:
    type: uint8-array
    default: [0x31, 0x3c]
    description:
      VCOM control 1 (VMCTRL1) register values.

  vmctrl2:
    type: uint8-array
    default: [0xc0]
    description:
      VCOM control 2 (VMCTRL2) register values.

  pgamctrl:
    type: uint8-array
    default: [
      0x0f,
      0x22,
      0x1f,
      0x0a,
      0x0e,
      0x06,
      0x4d,
      0x76,
      0x3b,
      0x03,
      0x0e,
      0x04,
      0x13,
      0x0e,
      0x0c
    ]
    description:
      Positive gamma correction (PGAMCTRL) register values.

  ngamctrl:
    type: uint8-array
    default: [
      0x0c,
      0x23,
      0x26,
      0x04,
      0x10,
      0x04,
      0x39,
      0x24,
      0x4b,
      0x03,
      0x0b,
      0x0b,
      0x33,
      0x37,
      0x0f
    ]
    description:
      Negative gamma correction (NGAMCTRL) register values.
```

## workspace/west.yml
```yaml
manifest:
  defaults:
    remote: zephyrproject-rtos

  remotes:
    - name: zephyrproject-rtos
      url-base: https://github.com/zephyrproject-rtos
    - name: ottojo
      url-base: https://github.com/ottojo

  projects:
    - name: zephyr
      remote: zephyrproject-rtos
      revision: v4.0.0
      import:

        name-allowlist:
          - cmsis
          - hal_xtensa
          - hal_espressif
          - hal
          - mbedtls
    - name: zephyr_fusb302b
      remote: ottojo
      revision: main
```
